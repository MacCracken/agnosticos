## kernel/6.6-lts/configs/edge_x86_64_defconfig
```kconfig
# AGNOS Edge Kernel Configuration — x86_64
# Linux 6.6 LTS — Minimal hardened config for edge/IoT devices
# Target: <5 MB compressed kernel (bzImage)
#
# Design goals:
#   - Minimal attack surface (no GUI, no sound, no exotic drivers)
#   - Full security stack (Landlock, seccomp, dm-verity, TPM 2.0)
#   - Networking (TCP/IP, WireGuard) for fleet management
#   - Read-only rootfs support (dm-verity, squashfs)

# ---------------------------------------------------------------------------
# General setup
# ---------------------------------------------------------------------------
CONFIG_LOCALVERSION="-agnos-edge"
CONFIG_LOCALVERSION_AUTO=y
CONFIG_DEFAULT_HOSTNAME="agnos-edge"
CONFIG_SYSVIPC=y
CONFIG_POSIX_MQUEUE=y
CONFIG_NO_HZ_IDLE=y
CONFIG_HIGH_RES_TIMERS=y
CONFIG_PREEMPT_VOLUNTARY=y
CONFIG_IKCONFIG=y
CONFIG_IKCONFIG_PROC=y
CONFIG_LOG_BUF_SHIFT=14
CONFIG_PRINTK=y
CONFIG_BUG=y
CONFIG_EMBEDDED=y
CONFIG_EXPERT=y

# Optimize for size over speed
CONFIG_CC_OPTIMIZE_FOR_SIZE=y

# ---------------------------------------------------------------------------
# Processor type and features
# ---------------------------------------------------------------------------
CONFIG_SMP=y
CONFIG_X86_64=y
CONFIG_NR_CPUS=16
CONFIG_PROCESSOR_SELECT=y
CONFIG_CPU_SUP_INTEL=y
CONFIG_CPU_SUP_AMD=y
# Disable exotic CPU support
# CONFIG_CPU_SUP_CENTAUR is not set
# CONFIG_CPU_SUP_ZHAOXIN is not set
# CONFIG_CPU_SUP_HYGON is not set

# Hardware features for common edge x86 hardware (NUCs, thin clients)
CONFIG_X86_INTEL_LPSS=y
CONFIG_X86_AMD_PLATFORM_DEVICE=y
CONFIG_MTRR=y
CONFIG_X86_PAT=y

# Hypervisor support (edge may run virtualized)
CONFIG_HYPERVISOR_GUEST=y
CONFIG_PARAVIRT=y
CONFIG_KVM_GUEST=y
# CONFIG_XEN is not set

# Memory protection
CONFIG_PAGE_TABLE_ISOLATION=y
CONFIG_RETPOLINE=y
CONFIG_RANDOMIZE_BASE=y
CONFIG_RANDOMIZE_MEMORY=y

# ---------------------------------------------------------------------------
# Security features (full AGNOS security stack)
# ---------------------------------------------------------------------------
CONFIG_SECURITY=y
CONFIG_SECURITY_LANDLOCK=y
CONFIG_SECCOMP=y
CONFIG_SECCOMP_FILTER=y
CONFIG_SECURITY_YAMA=y
CONFIG_SECURITY_LOCKDOWN_LSM=y
CONFIG_SECURITY_LOCKDOWN_LSM_EARLY=y
CONFIG_LOCK_DOWN_KERNEL_FORCE_INTEGRITY=y

# IMA/EVM for integrity measurement
CONFIG_INTEGRITY=y
CONFIG_IMA=y
CONFIG_IMA_MEASURE_PCR_IDX=10
CONFIG_IMA_LSM_RULES=y
CONFIG_IMA_APPRAISE=y
CONFIG_IMA_APPRAISE_BOOTPARAM=y
CONFIG_EVM=y

# AppArmor (lighter than SELinux for edge)
CONFIG_SECURITY_APPARMOR=y
CONFIG_DEFAULT_SECURITY_APPARMOR=y
# CONFIG_SECURITY_SELINUX is not set

# Module signing
CONFIG_MODULES=y
CONFIG_MODULE_UNLOAD=y
CONFIG_MODULE_SIG=y
CONFIG_MODULE_SIG_FORCE=y
CONFIG_MODULE_SIG_SHA256=y

# Stack protector
CONFIG_STACKPROTECTOR=y
CONFIG_STACKPROTECTOR_STRONG=y

# Hardening
CONFIG_FORTIFY_SOURCE=y
CONFIG_INIT_ON_ALLOC_DEFAULT_ON=y
CONFIG_INIT_ON_FREE_DEFAULT_ON=y
CONFIG_HARDENED_USERCOPY=y

# ---------------------------------------------------------------------------
# Namespaces (required for AGNOS sandbox)
# ---------------------------------------------------------------------------
CONFIG_NAMESPACES=y
CONFIG_UTS_NS=y
CONFIG_TIME_NS=y
CONFIG_IPC_NS=y
CONFIG_USER_NS=y
CONFIG_PID_NS=y
CONFIG_NET_NS=y

# ---------------------------------------------------------------------------
# cgroups v2 (required for AGNOS resource control)
# ---------------------------------------------------------------------------
CONFIG_CGROUPS=y
CONFIG_CGROUP_CPUACCT=y
CONFIG_CGROUP_DEVICE=y
CONFIG_CGROUP_FREEZER=y
CONFIG_CGROUP_SCHED=y
CONFIG_CGROUP_PIDS=y
CONFIG_CGROUP_BPF=y
CONFIG_CGROUP_MISC=y
CONFIG_MEMCG=y

# ---------------------------------------------------------------------------
# BPF (required for seccomp, Landlock)
# ---------------------------------------------------------------------------
CONFIG_BPF=y
CONFIG_BPF_SYSCALL=y
CONFIG_BPF_JIT=y
CONFIG_BPF_LSM=y

# ---------------------------------------------------------------------------
# Networking (TCP/IP + WireGuard only)
# ---------------------------------------------------------------------------
CONFIG_NET=y
CONFIG_PACKET=y
CONFIG_UNIX=y
CONFIG_INET=y
CONFIG_IP_MULTICAST=y
CONFIG_IP_ADVANCED_ROUTER=y
CONFIG_IP_MULTIPLE_TABLES=y
CONFIG_IP_ROUTE_MULTIPATH=y
CONFIG_IPV6=y
CONFIG_IPV6_ROUTER_PREF=y
CONFIG_IPV6_MULTIPLE_TABLES=y

# Netfilter (nftables for AGNOS firewall)
CONFIG_NETFILTER=y
CONFIG_NF_CONNTRACK=y
CONFIG_NF_NAT=y
CONFIG_NF_TABLES=y
CONFIG_NF_TABLES_INET=y
CONFIG_NFT_CT=y
CONFIG_NFT_NAT=y
CONFIG_NFT_MASQ=y
CONFIG_NFT_REJECT=y
CONFIG_NFT_LOG=y
CONFIG_NFT_LIMIT=y

# WireGuard VPN (fleet management tunnel)
CONFIG_WIREGUARD=y

# TLS for in-kernel TLS offload
CONFIG_TLS=y

# Disable uncommon network protocols
# CONFIG_SCTP is not set
# CONFIG_RDS is not set
# CONFIG_TIPC is not set
# CONFIG_DCCP is not set
# CONFIG_ATM is not set
# CONFIG_BRIDGE is not set
# CONFIG_VLAN_8021Q is not set
# CONFIG_DECNET is not set
# CONFIG_LLC2 is not set
# CONFIG_ATALK is not set
# CONFIG_X25 is not set
# CONFIG_LAPB is not set
# CONFIG_PHONET is not set
# CONFIG_IEEE802154 is not set
# CONFIG_CAIF is not set

# Disable Bluetooth and wireless (edge typically uses ethernet)
# CONFIG_BT is not set
# CONFIG_CFG80211 is not set
# CONFIG_WIRELESS is not set

# ---------------------------------------------------------------------------
# Device mapper (dm-verity, dm-crypt for verified/encrypted rootfs)
# ---------------------------------------------------------------------------
CONFIG_BLK_DEV=y
CONFIG_BLK_DEV_LOOP=y
CONFIG_BLK_DEV_DM=y
CONFIG_DM_CRYPT=y
CONFIG_DM_VERITY=y
CONFIG_DM_VERITY_VERIFY_ROOTHASH_SIG=y

# ---------------------------------------------------------------------------
# File systems (minimal: ext4, vfat for EFI, squashfs for rootfs)
# ---------------------------------------------------------------------------
CONFIG_EXT4_FS=y
CONFIG_EXT4_FS_POSIX_ACL=y
CONFIG_EXT4_FS_SECURITY=y
CONFIG_VFAT_FS=y
CONFIG_FAT_DEFAULT_UTF8=y
CONFIG_NLS_CODEPAGE_437=y
CONFIG_NLS_ISO8859_1=y
CONFIG_NLS_UTF8=y

# SquashFS for read-only rootfs
CONFIG_SQUASHFS=y
CONFIG_SQUASHFS_ZSTD=y

# OverlayFS for writable layer on top of squashfs
CONFIG_OVERLAY_FS=y

# Proc/sys/devtmpfs
CONFIG_PROC_FS=y
CONFIG_SYSFS=y
CONFIG_TMPFS=y
CONFIG_TMPFS_POSIX_ACL=y
CONFIG_DEVTMPFS=y
CONFIG_DEVTMPFS_MOUNT=y

# inotify for file watching
CONFIG_INOTIFY_USER=y
CONFIG_FANOTIFY=y

# Disable everything else
# CONFIG_BTRFS_FS is not set
# CONFIG_XFS_FS is not set
# CONFIG_F2FS_FS is not set
# CONFIG_REISERFS_FS is not set
# CONFIG_JFS_FS is not set
# CONFIG_NFSD is not set
# CONFIG_NFS_FS is not set
# CONFIG_CIFS is not set
# CONFIG_CRAMFS is not set
# CONFIG_FREEVXFS_FS is not set
# CONFIG_JFFS2_FS is not set
# CONFIG_HFS_FS is not set
# CONFIG_HFSPLUS_FS is not set
# CONFIG_UDF_FS is not set
# CONFIG_GFS2_FS is not set
# CONFIG_OCFS2_FS is not set
# CONFIG_NTFS3_FS is not set

# ---------------------------------------------------------------------------
# Block devices (NVMe, SATA, virtio)
# ---------------------------------------------------------------------------
CONFIG_SATA_AHCI=y
CONFIG_ATA_PIIX=y
CONFIG_NVME_CORE=y
CONFIG_NVME_PCI=y
CONFIG_VIRTIO=y
CONFIG_VIRTIO_PCI=y
CONFIG_VIRTIO_BLK=y
CONFIG_VIRTIO_NET=y
CONFIG_VIRTIO_CONSOLE=y

# ---------------------------------------------------------------------------
# USB (host only, storage class for firmware updates)
# ---------------------------------------------------------------------------
CONFIG_USB_SUPPORT=y
CONFIG_USB=y
CONFIG_USB_XHCI_HCD=y
CONFIG_USB_EHCI_HCD=y
CONFIG_USB_STORAGE=y
# CONFIG_USB_PRINTER is not set
# CONFIG_USB_SERIAL is not set

# ---------------------------------------------------------------------------
# TPM 2.0 (hardware root of trust)
# ---------------------------------------------------------------------------
CONFIG_TCG_TPM=y
CONFIG_TCG_TIS=y
CONFIG_TCG_CRB=y
CONFIG_TCG_VTPM_PROXY=y

# ---------------------------------------------------------------------------
# Crypto (AES, SHA-256, ChaCha20 for WireGuard)
# ---------------------------------------------------------------------------
CONFIG_CRYPTO=y
CONFIG_CRYPTO_SHA256=y
CONFIG_CRYPTO_SHA512=y
CONFIG_CRYPTO_AES=y
CONFIG_CRYPTO_GCM=y
CONFIG_CRYPTO_CHACHA20POLY1305=y
CONFIG_CRYPTO_CURVE25519=y
CONFIG_CRYPTO_BLAKE2B=y

# Hardware crypto acceleration
CONFIG_CRYPTO_AES_NI_INTEL=y
CONFIG_CRYPTO_SHA256_SSSE3=y
CONFIG_CRYPTO_SHA512_SSSE3=y

# ---------------------------------------------------------------------------
# Graphics / Sound / Media — DISABLED
# ---------------------------------------------------------------------------
# CONFIG_DRM is not set
# CONFIG_FB is not set
# CONFIG_VGA_CONSOLE is not set
# CONFIG_SOUND is not set
# CONFIG_SND is not set
# CONFIG_MEDIA_SUPPORT is not set

# Use serial console for edge devices
CONFIG_SERIAL_8250=y
CONFIG_SERIAL_8250_CONSOLE=y
CONFIG_VT=y
CONFIG_VT_CONSOLE=y

# ---------------------------------------------------------------------------
# Power management
# ---------------------------------------------------------------------------
CONFIG_CPU_FREQ=y
CONFIG_CPU_FREQ_DEFAULT_GOV_SCHEDUTIL=y
CONFIG_ACPI=y
CONFIG_ACPI_CPPC_CPUFREQ=y

# ---------------------------------------------------------------------------
# Watchdog (hardware watchdog for unattended edge recovery)
# ---------------------------------------------------------------------------
CONFIG_WATCHDOG=y
CONFIG_WATCHDOG_CORE=y
CONFIG_ITCO_WDT=y

# ---------------------------------------------------------------------------
# GPIO / I2C / SPI (edge sensor connectivity)
# ---------------------------------------------------------------------------
CONFIG_GPIOLIB=y
CONFIG_I2C=y
CONFIG_I2C_CHARDEV=y
CONFIG_SPI=y

# ---------------------------------------------------------------------------
# RTC (real-time clock)
# ---------------------------------------------------------------------------
CONFIG_RTC_CLASS=y
CONFIG_RTC_DRV_CMOS=y

# ---------------------------------------------------------------------------
# Disable — debugging, profiling, tracing (not for production edge)
# ---------------------------------------------------------------------------
# CONFIG_DEBUG_KERNEL is not set
# CONFIG_DEBUG_INFO is not set
# CONFIG_DEBUG_FS is not set
# CONFIG_PROFILING is not set
# CONFIG_FTRACE is not set
# CONFIG_KPROBES is not set
# CONFIG_KGDB is not set
# CONFIG_DEBUG_BUGVERBOSE is not set
# CONFIG_SLUB_DEBUG is not set

# ---------------------------------------------------------------------------
# Disable — drivers not needed on edge
# ---------------------------------------------------------------------------
# CONFIG_INPUT_JOYDEV is not set
# CONFIG_INPUT_JOYSTICK is not set
# CONFIG_INPUT_TABLET is not set
# CONFIG_INPUT_TOUCHSCREEN is not set
# CONFIG_INPUT_MOUSE is not set
# CONFIG_FIREWIRE is not set
# CONFIG_THUNDERBOLT is not set
# CONFIG_INFINIBAND is not set
# CONFIG_ISDN is not set
# CONFIG_PCMCIA is not set
# CONFIG_PARPORT is not set
# CONFIG_GAMEPORT is not set
# CONFIG_CDROM is not set

# Disable automounting
# CONFIG_AUTOMOUNT is not set

# ---------------------------------------------------------------------------
# Disable — uncommon network drivers
# ---------------------------------------------------------------------------
# CONFIG_NET_VENDOR_3COM is not set
# CONFIG_NET_VENDOR_ADAPTEC is not set
# CONFIG_NET_VENDOR_ALTEON is not set
# CONFIG_NET_VENDOR_CHELSIO is not set
# CONFIG_NET_VENDOR_CISCO is not set
# CONFIG_NET_VENDOR_DEC is not set
# CONFIG_NET_VENDOR_DLINK is not set
# CONFIG_NET_VENDOR_EMULEX is not set
# CONFIG_NET_VENDOR_MYRI is not set
# CONFIG_NET_VENDOR_NATSEMI is not set
# CONFIG_NET_VENDOR_NVIDIA is not set
# CONFIG_NET_VENDOR_OKI is not set
# CONFIG_NET_VENDOR_QLOGIC is not set
# CONFIG_NET_VENDOR_SIS is not set
# CONFIG_NET_VENDOR_SMSC is not set
# CONFIG_NET_VENDOR_SUN is not set
# CONFIG_NET_VENDOR_TEHUTI is not set
# CONFIG_NET_VENDOR_VIA is not set

# Keep: Intel and Realtek (common edge NICs)
CONFIG_E1000E=y
CONFIG_IGB=y
CONFIG_IXGBE=y
CONFIG_R8169=y

# ---------------------------------------------------------------------------
# EFI boot
# ---------------------------------------------------------------------------
CONFIG_EFI=y
CONFIG_EFI_STUB=y
CONFIG_EFI_MIXED=y
CONFIG_EFIVAR_FS=y

# ---------------------------------------------------------------------------
# AGNOS-specific kernel modules
# ---------------------------------------------------------------------------
CONFIG_AGNOS_SECURITY=m
CONFIG_AGNOS_AGENT_SUBSYSTEM=m
CONFIG_AGNOS_AUDIT=m

# ---------------------------------------------------------------------------
# Boot command line
# ---------------------------------------------------------------------------
CONFIG_CMDLINE_BOOL=y
CONFIG_CMDLINE="quiet loglevel=3 agnos.security.enforce=1 agnos.audit.enabled=1 audit=1 agnos.edge=1 ro rootfstype=squashfs"
```

## kernel/6.x-stable/configs/agnos_defconfig
```kconfig
# AGNOS Kernel Configuration
# Linux 6.6 LTS Hardened Configuration
# Based on x86_64 architecture

# Base kernel settings
CONFIG_LOCALVERSION="-agnos"
CONFIG_LOCALVERSION_AUTO=y

# Processor type and features
CONFIG_SMP=y
CONFIG_X86_64=y
CONFIG_X86_INTEL_LPSS=y
CONFIG_X86_AMD_PLATFORM_DEVICE=y
CONFIG_HYPERVISOR_GUEST=y
CONFIG_PARAVIRT=y
CONFIG_XEN=y
CONFIG_KVM_GUEST=y

# Security features
CONFIG_SECURITY=y
CONFIG_SECURITY_SELINUX=y
CONFIG_SECURITY_LANDLOCK=y
CONFIG_SECURITY_SECCOMP=y
CONFIG_SECURITY_SECCOMP_FILTER=y
CONFIG_SECURITY_YAMA=y
CONFIG_SECURITY_SAFESETID=y
CONFIG_SECURITY_LOCKDOWN_LSM=y
CONFIG_INTEGRITY=y
CONFIG_IMA=y
CONFIG_EVM=y
CONFIG_DEFAULT_SECURITY_SELINUX=y

# Memory protection
CONFIG_PAGE_TABLE_ISOLATION=y
CONFIG_RETPOLINE=y

# Namespaces
CONFIG_NAMESPACES=y
CONFIG_UTS_NS=y
CONFIG_TIME_NS=y
CONFIG_IPC_NS=y
CONFIG_USER_NS=y
CONFIG_USER_NS_UNPRIVILEGED=y
CONFIG_PID_NS=y
CONFIG_NET_NS=y
CONFIG_CGROUP_NS=y

# cgroups
CONFIG_CGROUPS=y
CONFIG_CGROUP_CPUACCT=y
CONFIG_CGROUP_DEVICE=y
CONFIG_CGROUP_FREEZER=y
CONFIG_CGROUP_SCHED=y
CONFIG_CGROUP_PIDS=y
CONFIG_CGROUP_RDMA=y
CONFIG_CGROUP_BPF=y
CONFIG_CGROUP_MISC=y

# BPF
CONFIG_BPF=y
CONFIG_BPF_SYSCALL=y
CONFIG_BPF_JIT=y
CONFIG_BPF_LSM=y

# Seccomp
CONFIG_SECCOMP=y
CONFIG_SECCOMP_FILTER=y

# Kernel module settings
CONFIG_MODULES=y
CONFIG_MODULE_UNLOAD=y
CONFIG_MODULE_SIG=y
CONFIG_MODULE_SIG_FORCE=y
CONFIG_MODULE_SIG_SHA256=y

# AGNOS-specific kernel modules
CONFIG_AGNOS_SECURITY=m
CONFIG_AGNOS_AGENT_SUBSYSTEM=m
CONFIG_AGNOS_LLM=m
CONFIG_AGNOS_AUDIT=m

# File systems
CONFIG_EXT4_FS=y
CONFIG_EXT4_FS_POSIX_ACL=y
CONFIG_EXT4_FS_SECURITY=y
CONFIG_BTRFS_FS=y
CONFIG_XFS_FS=y
CONFIG_FANOTIFY=y
CONFIG_OVERLAY_FS=y

# Networking
CONFIG_NET=y
CONFIG_INET=y
CONFIG_IPV6=y
CONFIG_NETFILTER=y
CONFIG_NF_CONNTRACK=y
CONFIG_NF_NAT=y
CONFIG_NF_TABLES=y

# CIS 1.1.5 - Disable automounting
CONFIG_AUTOMOUNT=n

# CIS 1.1.6 - Disable USB storage (attack vector reduction)
CONFIG_USB_STORAGE=n

# CIS 1.1.7 - Disable FireWire (DMA attack prevention)
CONFIG_FIREWIRE=n
CONFIG_FIREWIRE_OHCI=n

# CIS 1.1.8 - Disable Thunderbolt (DMA attack prevention)
CONFIG_THUNDERBOLT=n

# Disable uncommon network protocols (CIS 3.4.x)
CONFIG_SCTP=n
CONFIG_RDS=n
CONFIG_TIPC=n
CONFIG_DCCP=n

# Disable unused filesystems
CONFIG_NFSD=n
CONFIG_CRAMFS=n
CONFIG_FREEVXFS_FS=n
CONFIG_JFFS2_FS=n
CONFIG_HFS_FS=n
CONFIG_HFSPLUS_FS=n
CONFIG_UDF_FS=n

# Device drivers
CONFIG_BLK_DEV=y
CONFIG_BLK_DEV_LOOP=y
CONFIG_SATA_AHCI=y
CONFIG_NVME_CORE=y

# Graphics
CONFIG_DRM=y
CONFIG_DRM_I915=y
CONFIG_DRM_AMDGPU=y

# Virtualization
CONFIG_VIRTIO=y
CONFIG_VIRTIO_PCI=y
CONFIG_VIRTIO_BLK=y
CONFIG_VIRTIO_NET=y

# Power management
CONFIG_CPU_FREQ=y
CONFIG_CPU_FREQ_DEFAULT_GOV_SCHEDUTIL=y

# Crypto
CONFIG_CRYPTO=y
CONFIG_CRYPTO_SHA256=y
CONFIG_CRYPTO_AES=y
CONFIG_CRYPTO_GCM=y

# AppArmor support
CONFIG_SECURITY_APPARMOR=y

# Boot options
CONFIG_CMDLINE="quiet loglevel=3 agnos.security.enforce=1 agnos.audit.enabled=1 audit=1 audit_backlog_limit=8192"
```
