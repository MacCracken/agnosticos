## kernel/6.6-lts/configs/edge_aarch64_defconfig
```kconfig
# AGNOS Edge Kernel Configuration — aarch64 (Raspberry Pi 4/5)
# Linux 6.6 LTS — Minimal hardened config for ARM64 edge devices
# Target: <5 MB compressed kernel (Image.gz)
#
# Design goals:
#   - Raspberry Pi 4 (BCM2711) and Pi 5 (BCM2712) support
#   - Full AGNOS security stack (Landlock, seccomp, dm-verity, TPM)
#   - Networking (TCP/IP, WireGuard, brcmfmac WiFi)
#   - GPIO/I2C/SPI for sensor and actuator connectivity
#   - Read-only rootfs support (dm-verity, squashfs)

# ---------------------------------------------------------------------------
# General setup
# ---------------------------------------------------------------------------
CONFIG_LOCALVERSION="-agnos-edge"
CONFIG_LOCALVERSION_AUTO=y
CONFIG_DEFAULT_HOSTNAME="agnos-edge"
CONFIG_SYSVIPC=y
CONFIG_POSIX_MQUEUE=y
CONFIG_NO_HZ_IDLE=y
CONFIG_HIGH_RES_TIMERS=y
CONFIG_PREEMPT_VOLUNTARY=y
CONFIG_IKCONFIG=y
CONFIG_IKCONFIG_PROC=y
CONFIG_LOG_BUF_SHIFT=14
CONFIG_PRINTK=y
CONFIG_BUG=y
CONFIG_EMBEDDED=y
CONFIG_EXPERT=y

# Optimize for size over speed
CONFIG_CC_OPTIMIZE_FOR_SIZE=y

# ---------------------------------------------------------------------------
# Platform — ARM64 / Broadcom BCM2835 family
# ---------------------------------------------------------------------------
CONFIG_ARM64=y
CONFIG_ARCH_BCM=y
CONFIG_ARCH_BCM2835=y
CONFIG_SMP=y
CONFIG_NR_CPUS=4

# RPi firmware interface
CONFIG_RASPBERRYPI_FIRMWARE=y
CONFIG_RASPBERRYPI_POWER=y

# Device tree
CONFIG_OF=y
CONFIG_OF_OVERLAY=y
CONFIG_OF_CONFIGFS=y

# ARM crypto extensions
CONFIG_ARM64_CRYPTO=y
CONFIG_CRYPTO_SHA256_ARM64=y
CONFIG_CRYPTO_SHA512_ARM64=y
CONFIG_CRYPTO_AES_ARM64=y
CONFIG_CRYPTO_AES_ARM64_CE=y
CONFIG_CRYPTO_AES_ARM64_CE_BLK=y
CONFIG_CRYPTO_CHACHA20_NEON=y

# ---------------------------------------------------------------------------
# Security features (full AGNOS security stack)
# ---------------------------------------------------------------------------
CONFIG_SECURITY=y
CONFIG_SECURITY_LANDLOCK=y
CONFIG_SECCOMP=y
CONFIG_SECCOMP_FILTER=y
CONFIG_SECURITY_YAMA=y
CONFIG_SECURITY_LOCKDOWN_LSM=y
CONFIG_SECURITY_LOCKDOWN_LSM_EARLY=y
CONFIG_LOCK_DOWN_KERNEL_FORCE_INTEGRITY=y

# IMA/EVM for integrity measurement
CONFIG_INTEGRITY=y
CONFIG_IMA=y
CONFIG_IMA_MEASURE_PCR_IDX=10
CONFIG_IMA_LSM_RULES=y
CONFIG_IMA_APPRAISE=y
CONFIG_IMA_APPRAISE_BOOTPARAM=y
CONFIG_EVM=y

# AppArmor (lighter than SELinux for edge)
CONFIG_SECURITY_APPARMOR=y
CONFIG_DEFAULT_SECURITY_APPARMOR=y
# CONFIG_SECURITY_SELINUX is not set

# Module signing
CONFIG_MODULES=y
CONFIG_MODULE_UNLOAD=y
CONFIG_MODULE_SIG=y
CONFIG_MODULE_SIG_FORCE=y
CONFIG_MODULE_SIG_SHA256=y

# Stack protector
CONFIG_STACKPROTECTOR=y
CONFIG_STACKPROTECTOR_STRONG=y

# Hardening
CONFIG_FORTIFY_SOURCE=y
CONFIG_INIT_ON_ALLOC_DEFAULT_ON=y
CONFIG_INIT_ON_FREE_DEFAULT_ON=y
CONFIG_HARDENED_USERCOPY=y

# ---------------------------------------------------------------------------
# Namespaces (required for AGNOS sandbox)
# ---------------------------------------------------------------------------
CONFIG_NAMESPACES=y
CONFIG_UTS_NS=y
CONFIG_TIME_NS=y
CONFIG_IPC_NS=y
CONFIG_USER_NS=y
CONFIG_PID_NS=y
CONFIG_NET_NS=y

# ---------------------------------------------------------------------------
# cgroups v2 (required for AGNOS resource control)
# ---------------------------------------------------------------------------
CONFIG_CGROUPS=y
CONFIG_CGROUP_CPUACCT=y
CONFIG_CGROUP_DEVICE=y
CONFIG_CGROUP_FREEZER=y
CONFIG_CGROUP_SCHED=y
CONFIG_CGROUP_PIDS=y
CONFIG_CGROUP_BPF=y
CONFIG_CGROUP_MISC=y
CONFIG_MEMCG=y

# ---------------------------------------------------------------------------
# BPF (required for seccomp, Landlock)
# ---------------------------------------------------------------------------
CONFIG_BPF=y
CONFIG_BPF_SYSCALL=y
CONFIG_BPF_JIT=y
CONFIG_BPF_LSM=y

# ---------------------------------------------------------------------------
# Networking (TCP/IP + WireGuard + WiFi for RPi)
# ---------------------------------------------------------------------------
CONFIG_NET=y
CONFIG_PACKET=y
CONFIG_UNIX=y
CONFIG_INET=y
CONFIG_IP_MULTICAST=y
CONFIG_IP_ADVANCED_ROUTER=y
CONFIG_IP_MULTIPLE_TABLES=y
CONFIG_IP_ROUTE_MULTIPATH=y
CONFIG_IPV6=y
CONFIG_IPV6_ROUTER_PREF=y
CONFIG_IPV6_MULTIPLE_TABLES=y

# Netfilter (nftables for AGNOS firewall)
CONFIG_NETFILTER=y
CONFIG_NF_CONNTRACK=y
CONFIG_NF_NAT=y
CONFIG_NF_TABLES=y
CONFIG_NF_TABLES_INET=y
CONFIG_NFT_CT=y
CONFIG_NFT_NAT=y
CONFIG_NFT_MASQ=y
CONFIG_NFT_REJECT=y
CONFIG_NFT_LOG=y
CONFIG_NFT_LIMIT=y

# WireGuard VPN (fleet management tunnel)
CONFIG_WIREGUARD=y

# TLS for in-kernel TLS offload
CONFIG_TLS=y

# WiFi (brcmfmac for RPi onboard WiFi)
CONFIG_CFG80211=m
CONFIG_MAC80211=m
CONFIG_BRCMUTIL=m
CONFIG_BRCMFMAC=m
CONFIG_BRCMFMAC_SDIO=y

# Disable uncommon network protocols
# CONFIG_SCTP is not set
# CONFIG_RDS is not set
# CONFIG_TIPC is not set
# CONFIG_DCCP is not set
# CONFIG_ATM is not set
# CONFIG_BRIDGE is not set
# CONFIG_VLAN_8021Q is not set
# CONFIG_DECNET is not set
# CONFIG_LLC2 is not set
# CONFIG_ATALK is not set
# CONFIG_X25 is not set
# CONFIG_LAPB is not set
# CONFIG_PHONET is not set
# CONFIG_IEEE802154 is not set
# CONFIG_CAIF is not set

# Disable Bluetooth (not needed for headless edge)
# CONFIG_BT is not set

# ---------------------------------------------------------------------------
# Device mapper (dm-verity, dm-crypt for verified/encrypted rootfs)
# ---------------------------------------------------------------------------
CONFIG_BLK_DEV=y
CONFIG_BLK_DEV_LOOP=y
CONFIG_BLK_DEV_DM=y
CONFIG_DM_CRYPT=y
CONFIG_DM_VERITY=y
CONFIG_DM_VERITY_VERIFY_ROOTHASH_SIG=y

# ---------------------------------------------------------------------------
# File systems (minimal: ext4, vfat for boot, squashfs for rootfs)
# ---------------------------------------------------------------------------
CONFIG_EXT4_FS=y
CONFIG_EXT4_FS_POSIX_ACL=y
CONFIG_EXT4_FS_SECURITY=y
CONFIG_VFAT_FS=y
CONFIG_FAT_DEFAULT_UTF8=y
CONFIG_NLS_CODEPAGE_437=y
CONFIG_NLS_ISO8859_1=y
CONFIG_NLS_UTF8=y

# SquashFS for read-only rootfs
CONFIG_SQUASHFS=y
CONFIG_SQUASHFS_ZSTD=y

# OverlayFS for writable layer on top of squashfs
CONFIG_OVERLAY_FS=y

# Proc/sys/devtmpfs
CONFIG_PROC_FS=y
CONFIG_SYSFS=y
CONFIG_TMPFS=y
CONFIG_TMPFS_POSIX_ACL=y
CONFIG_DEVTMPFS=y
CONFIG_DEVTMPFS_MOUNT=y

# inotify for file watching
CONFIG_INOTIFY_USER=y
CONFIG_FANOTIFY=y

# Disable everything else
# CONFIG_BTRFS_FS is not set
# CONFIG_XFS_FS is not set
# CONFIG_F2FS_FS is not set
# CONFIG_REISERFS_FS is not set
# CONFIG_JFS_FS is not set
# CONFIG_NFSD is not set
# CONFIG_NFS_FS is not set
# CONFIG_CIFS is not set
# CONFIG_CRAMFS is not set
# CONFIG_FREEVXFS_FS is not set
# CONFIG_JFFS2_FS is not set
# CONFIG_HFS_FS is not set
# CONFIG_HFSPLUS_FS is not set
# CONFIG_UDF_FS is not set
# CONFIG_GFS2_FS is not set
# CONFIG_OCFS2_FS is not set
# CONFIG_NTFS3_FS is not set

# ---------------------------------------------------------------------------
# SD/MMC (RPi boot from SD card)
# ---------------------------------------------------------------------------
CONFIG_MMC=y
CONFIG_MMC_BLOCK=y
CONFIG_MMC_SDHCI=y
CONFIG_MMC_SDHCI_PLTFM=y
CONFIG_MMC_BCM2835=y
CONFIG_MMC_SDHCI_IPROC=y

# ---------------------------------------------------------------------------
# USB (RPi USB host controller — dwc2)
# ---------------------------------------------------------------------------
CONFIG_USB_SUPPORT=y
CONFIG_USB=y
CONFIG_USB_XHCI_HCD=y
CONFIG_USB_DWC2=y
CONFIG_USB_DWC2_HOST=y
CONFIG_USB_STORAGE=y
# CONFIG_USB_PRINTER is not set
# CONFIG_USB_SERIAL is not set

# ---------------------------------------------------------------------------
# Ethernet (RPi onboard genet + USB ethernet)
# ---------------------------------------------------------------------------
CONFIG_NETDEVICES=y
CONFIG_ETHERNET=y
CONFIG_NET_VENDOR_BROADCOM=y
CONFIG_BCMGENET=y
CONFIG_USB_NET_DRIVERS=y
CONFIG_USB_USBNET=y
CONFIG_USB_NET_SMSC95XX=y

# ---------------------------------------------------------------------------
# GPIO / I2C / SPI / UART (RPi peripheral connectivity)
# ---------------------------------------------------------------------------
CONFIG_GPIOLIB=y
CONFIG_GPIO_BCM_VIRT=y
CONFIG_PINCTRL=y
CONFIG_PINCTRL_BCM2835=y

CONFIG_I2C=y
CONFIG_I2C_CHARDEV=y
CONFIG_I2C_BCM2835=y
CONFIG_I2C_BRCMSTB=y

CONFIG_SPI=y
CONFIG_SPI_BCM2835=y
CONFIG_SPI_BCM2835AUX=y
CONFIG_SPI_SPIDEV=y

CONFIG_SERIAL_AMBA_PL011=y
CONFIG_SERIAL_AMBA_PL011_CONSOLE=y
CONFIG_SERIAL_8250=y
CONFIG_SERIAL_8250_CONSOLE=y
CONFIG_SERIAL_8250_BCM2835AUX=y

# ---------------------------------------------------------------------------
# TPM 2.0 (hardware root of trust — SPI TPM on edge hat, or fTPM)
# ---------------------------------------------------------------------------
CONFIG_TCG_TPM=y
CONFIG_TCG_TIS=y
CONFIG_TCG_TIS_SPI=y
CONFIG_TCG_CRB=y

# ---------------------------------------------------------------------------
# Crypto
# ---------------------------------------------------------------------------
CONFIG_CRYPTO=y
CONFIG_CRYPTO_SHA256=y
CONFIG_CRYPTO_SHA512=y
CONFIG_CRYPTO_AES=y
CONFIG_CRYPTO_GCM=y
CONFIG_CRYPTO_CHACHA20POLY1305=y
CONFIG_CRYPTO_CURVE25519=y
CONFIG_CRYPTO_BLAKE2B=y

# ---------------------------------------------------------------------------
# Graphics / Sound / Media — DISABLED
# ---------------------------------------------------------------------------
# CONFIG_DRM is not set
# CONFIG_FB is not set
# CONFIG_SOUND is not set
# CONFIG_SND is not set
# CONFIG_MEDIA_SUPPORT is not set

# Console on serial port
CONFIG_VT=y
CONFIG_VT_CONSOLE=y

# ---------------------------------------------------------------------------
# Power management
# ---------------------------------------------------------------------------
CONFIG_CPU_FREQ=y
CONFIG_CPU_FREQ_DEFAULT_GOV_SCHEDUTIL=y
CONFIG_ARM_SCPI_CPUFREQ=y
CONFIG_CPUFREQ_DT=y

# ---------------------------------------------------------------------------
# Thermal (RPi throttles at 80C)
# ---------------------------------------------------------------------------
CONFIG_THERMAL=y
CONFIG_CPU_THERMAL=y
CONFIG_BCM2835_THERMAL=y

# ---------------------------------------------------------------------------
# Watchdog (RPi hardware watchdog for unattended recovery)
# ---------------------------------------------------------------------------
CONFIG_WATCHDOG=y
CONFIG_WATCHDOG_CORE=y
CONFIG_BCM2835_WDT=y

# ---------------------------------------------------------------------------
# RTC
# ---------------------------------------------------------------------------
CONFIG_RTC_CLASS=y

# ---------------------------------------------------------------------------
# RPi firmware / mailbox / video core
# ---------------------------------------------------------------------------
CONFIG_MAILBOX=y
CONFIG_BCM2835_MBOX=y
CONFIG_RASPBERRYPI_FIRMWARE=y

# Hardware RNG
CONFIG_HW_RANDOM=y
CONFIG_HW_RANDOM_BCM2835=y
CONFIG_HW_RANDOM_IPROC_RNG200=y

# ---------------------------------------------------------------------------
# Disable — debugging, profiling, tracing (not for production edge)
# ---------------------------------------------------------------------------
# CONFIG_DEBUG_KERNEL is not set
# CONFIG_DEBUG_INFO is not set
# CONFIG_DEBUG_FS is not set
# CONFIG_PROFILING is not set
# CONFIG_FTRACE is not set
# CONFIG_KPROBES is not set
# CONFIG_KGDB is not set
# CONFIG_DEBUG_BUGVERBOSE is not set
# CONFIG_SLUB_DEBUG is not set

# ---------------------------------------------------------------------------
# Disable — drivers not needed on headless edge
# ---------------------------------------------------------------------------
# CONFIG_INPUT_JOYDEV is not set
# CONFIG_INPUT_JOYSTICK is not set
# CONFIG_INPUT_TABLET is not set
# CONFIG_INPUT_TOUCHSCREEN is not set
# CONFIG_INPUT_MOUSE is not set
# CONFIG_FIREWIRE is not set
# CONFIG_THUNDERBOLT is not set
# CONFIG_INFINIBAND is not set
# CONFIG_ISDN is not set
# CONFIG_PCMCIA is not set
# CONFIG_PARPORT is not set
# CONFIG_GAMEPORT is not set
# CONFIG_CDROM is not set

# Disable automounting
# CONFIG_AUTOMOUNT is not set

# ---------------------------------------------------------------------------
# AGNOS-specific kernel modules
# ---------------------------------------------------------------------------
CONFIG_AGNOS_SECURITY=m
CONFIG_AGNOS_AGENT_SUBSYSTEM=m
CONFIG_AGNOS_AUDIT=m

# ---------------------------------------------------------------------------
# Boot command line
# ---------------------------------------------------------------------------
CONFIG_CMDLINE="quiet loglevel=3 agnos.security.enforce=1 agnos.audit.enabled=1 audit=1 agnos.edge=1 ro rootfstype=squashfs"
```
